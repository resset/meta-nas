## conf/layer.conf
```bitbake
# We have a conf and classes directory, add to BBPATH
BBPATH .= ":${LAYERDIR}"

# We have recipes-* directories, add to BBFILES
BBFILES += "${LAYERDIR}/recipes-*/*/*.bb ${LAYERDIR}/recipes-*/*/*.bbappend"

BBFILE_COLLECTIONS += "nas"
BBFILE_PATTERN_nas = "^${LAYERDIR}/"
BBFILE_PRIORITY_nas = "15"

# This should only be incremented on significant changes that will
# cause compatibility issues with other layers
LAYERVERSION_skeleton = "1"

LAYERDEPENDS_skeleton = "core openembedded-layer meta-sunxi"

LAYERSERIES_COMPAT_nas = "dunfell"
```
